## boards/esp32s3/sdkconfig.defaults
```kconfig
# Rust often needs a bit of an extra main task stack size compared to C (the default is 3K)
CONFIG_ESP_MAIN_TASK_STACK_SIZE=8000

# Use this to set FreeRTOS kernel tick frequency to 1000 Hz (100 Hz by default).
# This allows to use 1 ms granuality for thread sleeps (10 ms by default).

CONFIG_FREERTOS_HZ=1000

CONFIG_ESP32S3_DEFAULT_CPU_FREQ_240=y
```
